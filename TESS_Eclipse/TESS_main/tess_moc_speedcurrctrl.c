/**
  ******************************************************************************
  * File Name          : tess_moc_speedcurrctrl.c
  * Author			       : Axinte Andrei
  * Description        : Speed and Current Control module source file
  ******************************************************************************
**/

#ifdef __cplusplus
extern "C" {
#endif


/*INCLUDES*/
#include "tess_moc_speedcurrctrl.h"

/*FUNCTIONS*/
static void TESS_MOC_SET_DIRECTION(unsigned_char_t left_m, unsigned_char_t right_m);

void TESS_MOC_SPEEDCURRCTRL_INIT()
{

  TESS_MOC_SPEEDCTRL_LEFTMOTOR.OUTPUT_CURRENT=0;
  TESS_MOC_SPEEDCTRL_LEFTMOTOR.OUTPUT_CURRENT_K1=0;
  TESS_MOC_SPEEDCTRL_LEFTMOTOR.ERROR_SPEED=0;
  TESS_MOC_SPEEDCTRL_LEFTMOTOR.P_GAIN=0.00000185;/*gains for speed controller when used only*/
  TESS_MOC_SPEEDCTRL_LEFTMOTOR.I_GAIN=0.000001880;
  //TESS_MOC_SPEEDCTRL_LEFTMOTOR.P_GAIN=0.0000000913;//0.0000014873;//0.0000089;//0.0000000856;//0.0000992;0.000000216;
  //TESS_MOC_SPEEDCTRL_LEFTMOTOR.I_GAIN=0.00000000075;//0.00005592;//0.00025;//0.0009;//0.0000095;0.0000000575;0.0000000175;

  TESS_MOC_SPEEDCTRL_RIGHTMOTOR.OUTPUT_CURRENT=0;
  TESS_MOC_SPEEDCTRL_RIGHTMOTOR.OUTPUT_CURRENT_K1=0;
  TESS_MOC_SPEEDCTRL_RIGHTMOTOR.ERROR_SPEED=0;
  TESS_MOC_SPEEDCTRL_RIGHTMOTOR.P_GAIN=0.00000496;//0.00000992;
  TESS_MOC_SPEEDCTRL_RIGHTMOTOR.I_GAIN=0.000000475;//0.000000950;

  TESS_MOC_CURRCTRL_LEFTMOTOR.OUTPUT_VOLTAGE=0;
  TESS_MOC_CURRCTRL_LEFTMOTOR.OUTPUT_VOLTAGE_K1=0;
  TESS_MOC_CURRCTRL_LEFTMOTOR.ERROR_CURRENT=0;
  TESS_MOC_CURRCTRL_LEFTMOTOR.P_GAIN=0;//0.0319;//0.75;
  TESS_MOC_CURRCTRL_LEFTMOTOR.I_GAIN=1887;//425.0;//0.2;//2887.97;
  
  TESS_MOC_CURRCTRL_RIGHTMOTOR.OUTPUT_VOLTAGE=0;
  TESS_MOC_CURRCTRL_RIGHTMOTOR.OUTPUT_VOLTAGE_K1=0;
  TESS_MOC_CURRCTRL_RIGHTMOTOR.ERROR_CURRENT=0;
  TESS_MOC_CURRCTRL_RIGHTMOTOR.P_GAIN=0;
  TESS_MOC_CURRCTRL_RIGHTMOTOR.I_GAIN=22.09;//2887.97;

  TESS_MOC_MOTOR_LEFT_DIR = 0;
  TESS_MOC_MOTOR_RIGHT_DIR = 0;

  Set_TessMocReqVoltageLeftM(0);
  Set_TessMocReqVoltageRightM(0);
  Set_TessStateMachReqSpeed(0);
}

void TESS_MOC_SPEEDCURRCTRL_MAIN()
{
   static float32 Integral_part;
   static float32 Proportional_part;
   static signed_int16_t loc_req_speed;
   loc_req_speed = Get_TessStateMachReqSpeed();
   static float32 loc_meas_curr_right = 0;
   static  float32 loc_meas_curr_left = 0;

   if(TESS_MOC_MOTOR_LEFT_DIR == FORWARD)
   {
	   loc_meas_curr_left = (float32)(Get_TessMipCurrLeft())/1000.0F;
   }
   else if(TESS_MOC_MOTOR_LEFT_DIR == BACKWARD)
   {
	   loc_meas_curr_left = (-1)*(float32)(Get_TessMipCurrLeft())/1000.0F;
   }

   if(TESS_MOC_MOTOR_RIGHT_DIR == FORWARD)
   {
	   loc_meas_curr_right = (float32)(Get_TessMipCurrRight())/1000.0F;
   }
   else if(TESS_MOC_MOTOR_RIGHT_DIR == BACKWARD)
   {
	   loc_meas_curr_right = (-1)*(float32)(Get_TessMipCurrRight())/1000.0F;
   }
   loc_req_speed = Get_TessStateMachReqSpeed();
#if CLOSED_LOOP
   Set_TessStateMachReqSpeed(/*TESS_MAP(Get_TessStateMachReqSpeed(),-16000,16000, -13000,13000)*/0);
   /*Left Motor*/
   TESS_MOC_SPEEDCTRL_LEFTMOTOR.ERROR_SPEED = (float32)(Get_TessStateMachReqSpeed()) - (float32)(Get_TessMipEstSpeedLeftM());
   TESS_MOC_SPEEDCTRL_LEFTMOTOR.P_PART = (TESS_MOC_SPEEDCTRL_LEFTMOTOR.P_GAIN * TESS_MOC_SPEEDCTRL_LEFTMOTOR.ERROR_SPEED);
   TESS_MOC_SPEEDCTRL_LEFTMOTOR.I_PART = TESS_MOC_SPEEDCTRL_LEFTMOTOR.OUTPUT_CURRENT_K1 + (TESS_MOC_SPEEDCTRL_LEFTMOTOR.I_GAIN * TESS_MOC_SPEEDCTRL_LEFTMOTOR.ERROR_SPEED)/TS;
   TESS_MOC_SPEEDCTRL_LEFTMOTOR.OUTPUT_CURRENT = TESS_MOC_SPEEDCTRL_LEFTMOTOR.P_PART + TESS_MOC_SPEEDCTRL_LEFTMOTOR.I_PART;
   TESS_MOC_SPEEDCTRL_LEFTMOTOR.OUTPUT_CURRENT = TESS_LIM(TESS_MOC_SPEEDCTRL_LEFTMOTOR.OUTPUT_CURRENT,-5.3, 5.3);

   TESS_MOC_SPEEDCTRL_LEFTMOTOR.OUTPUT_CURRENT_K1 = TESS_MOC_SPEEDCTRL_LEFTMOTOR.OUTPUT_CURRENT;

   /*Right Motor
   TESS_MOC_SPEEDCTRL_RIGHTMOTOR.ERROR_SPEED = Get_TessStateMachReqSpeed() - Get_TessMipEstSpeedRightM();
   Proportional_part = TESS_MOC_SPEEDCTRL_RIGHTMOTOR.P_GAIN * TESS_MOC_SPEEDCTRL_RIGHTMOTOR.ERROR_SPEED;
   Integral_part = TESS_MOC_SPEEDCTRL_RIGHTMOTOR.OUTPUT_CURRENT_K1 + (TESS_MOC_SPEEDCTRL_RIGHTMOTOR.I_GAIN * TESS_MOC_SPEEDCTRL_RIGHTMOTOR.ERROR_SPEED)/TS;
   TESS_MOC_SPEEDCTRL_RIGHTMOTOR.OUTPUT_CURRENT = Proportional_part + Integral_part;
   TESS_MOC_SPEEDCTRL_RIGHTMOTOR.OUTPUT_CURRENT = TESS_LIM(TESS_MOC_SPEEDCTRL_RIGHTMOTOR.OUTPUT_CURRENT,-4.5, 4.5);

   TESS_MOC_SPEEDCTRL_RIGHTMOTOR.OUTPUT_CURRENT_K1 = TESS_MOC_SPEEDCTRL_RIGHTMOTOR.OUTPUT_CURRENT;*/
   //loc_req_speed = (TESS_MOC_SPEEDCTRL_LEFTMOTOR.OUTPUT_CURRENT/DC_LINK_VOLT)*16000.0F;
#endif

#if 0

   /*Left Motor*/
   TESS_MOC_CURRCTRL_LEFTMOTOR.ERROR_CURRENT = TESS_MOC_SPEEDCTRL_LEFTMOTOR.OUTPUT_CURRENT - loc_meas_curr_left;//(float32)(Get_TessMipCurrLeft())/1000.0F;//
   Proportional_part = TESS_MOC_CURRCTRL_LEFTMOTOR.P_GAIN * TESS_MOC_CURRCTRL_LEFTMOTOR.ERROR_CURRENT;
   Integral_part = TESS_MOC_CURRCTRL_LEFTMOTOR.OUTPUT_VOLTAGE_K1 + (TESS_MOC_CURRCTRL_LEFTMOTOR.I_GAIN * TESS_MOC_CURRCTRL_LEFTMOTOR.ERROR_CURRENT)/TS;
   TESS_MOC_CURRCTRL_LEFTMOTOR.OUTPUT_VOLTAGE = Proportional_part + Integral_part;
   TESS_MOC_CURRCTRL_LEFTMOTOR.OUTPUT_VOLTAGE = TESS_LIM(TESS_MOC_CURRCTRL_LEFTMOTOR.OUTPUT_VOLTAGE,-5.3, 5.3);

   TESS_MOC_CURRCTRL_LEFTMOTOR.OUTPUT_VOLTAGE_K1 = TESS_MOC_CURRCTRL_LEFTMOTOR.OUTPUT_VOLTAGE;

   /*Right Motor
   TESS_MOC_CURRCTRL_RIGHTMOTOR.ERROR_CURRENT = TESS_MOC_SPEEDCTRL_RIGHTMOTOR.OUTPUT_CURRENT - loc_meas_curr_right;
   Proportional_part = TESS_MOC_CURRCTRL_RIGHTMOTOR.P_GAIN * TESS_MOC_CURRCTRL_RIGHTMOTOR.ERROR_CURRENT;
   Integral_part = TESS_MOC_CURRCTRL_RIGHTMOTOR.OUTPUT_VOLTAGE_K1 + (TESS_MOC_CURRCTRL_RIGHTMOTOR.I_GAIN * TESS_MOC_CURRCTRL_RIGHTMOTOR.ERROR_CURRENT)/TS;
   TESS_MOC_CURRCTRL_RIGHTMOTOR.OUTPUT_VOLTAGE = Proportional_part + Integral_part;
   TESS_MOC_CURRCTRL_RIGHTMOTOR.OUTPUT_VOLTAGE = TESS_LIM(TESS_MOC_CURRCTRL_RIGHTMOTOR.OUTPUT_VOLTAGE,-5.3, 5.3);

   TESS_MOC_CURRCTRL_RIGHTMOTOR.OUTPUT_VOLTAGE_K1 = TESS_MOC_CURRCTRL_RIGHTMOTOR.OUTPUT_VOLTAGE;*/

   loc_req_speed = (TESS_MOC_CURRCTRL_LEFTMOTOR.OUTPUT_VOLTAGE/DC_LINK_VOLT)*16000.0F;
#endif


   if (loc_req_speed > 250)
   {
      TESS_MOC_MOTOR_LEFT_DIR = FORWARD;
      Set_TessMocReqVoltageLeftM((unsigned_int16_t)(Absolut_value(loc_req_speed)));
      TESS_MOC_MOTOR_RIGHT_DIR = FORWARD;
      Set_TessMocReqVoltageRightM((unsigned_int16_t)(Absolut_value(loc_req_speed)));
   }else if (loc_req_speed < -250)
   {
      TESS_MOC_MOTOR_LEFT_DIR = BACKWARD;
      Set_TessMocReqVoltageLeftM((unsigned_int16_t)(Absolut_value(loc_req_speed)));
     TESS_MOC_MOTOR_RIGHT_DIR = BACKWARD;
      Set_TessMocReqVoltageRightM((unsigned_int16_t)(Absolut_value(loc_req_speed)));
   
   }else
   {
     Set_TessMocReqVoltageLeftM(0);
     Set_TessMocReqVoltageRightM(0);
   }
   //TESS_MOC_MOTOR_LEFT_DIR = FORWARD;
   //TESS_MOC_MOTOR_RIGHT_DIR = FORWARD;
   Set_TessBfuPwmDtcRight(Get_TessMocReqVoltageRightM());
   Set_TessBfuPwmDtcLeft(Get_TessMocReqVoltageLeftM());
   TESS_MOC_SET_DIRECTION(TESS_MOC_MOTOR_LEFT_DIR, TESS_MOC_MOTOR_RIGHT_DIR);
}

static void TESS_MOC_SET_DIRECTION(unsigned_char_t left_m, unsigned_char_t right_m)
{
/*
   TESS_IO_PIN_WRITE(&PORTD,LEFT_F, left_m);
   TESS_IO_PIN_WRITE(&PORTD,LEFT_B, !left_m);

   TESS_IO_PIN_WRITE(&PORTD,RIGHT_B, !right_m);
   TESS_IO_PIN_WRITE(&PORTD,RIGHT_F, right_m);
   */
   digitalWrite(LEFT_F,left_m);
   digitalWrite(LEFT_B,!left_m);
   digitalWrite(RIGHT_B,!right_m);
   digitalWrite(RIGHT_F,right_m);


}

#ifdef __cplusplus
}
#endif
